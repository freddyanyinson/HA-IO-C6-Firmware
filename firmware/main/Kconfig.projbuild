## firmware/main/Kconfig.projbuild
```kconfig
menu "HA-IO C6"

    config EXAMPLE_LIGHT_GPIO
        int "On/off light output GPIO"
        default 17
        range 0 30
        help
            GPIO used by the Zigbee On/Off cluster output on the XIAO ESP32-C6.

endmenu
```

## firmware/sdkconfig.defaults
```kconfig
CONFIG_EXAMPLE_LIGHT_GPIO=17
CONFIG_IDF_TARGET="esp32c6"
CONFIG_ZB_ENABLED=y
CONFIG_ZB_ZED=y
CONFIG_COMPILER_OPTIMIZATION_DEBUG=y
CONFIG_COMPILER_OPTIMIZATION_ASSERTIONS_ENABLE=y
CONFIG_LOG_DEFAULT_LEVEL_DEBUG=y
CONFIG_LOG_DEFAULT_LEVEL=4
CONFIG_ESP_SYSTEM_PANIC_PRINT_REBOOT=y
CONFIG_ESP_COREDUMP_ENABLE_TO_UART=y
CONFIG_ESPTOOLPY_MONITOR_BAUD=115200
```
